## config/west.yml
```yaml
manifest:
  defaults:
    revision: v0.3
  remotes:
    - name: zmkfirmware
      url-base: https://github.com/zmkfirmware
    - name: northwestisthebest
      url-base: https://github.com/northwestisthebest
  projects:
    - name: zmk
      remote: zmkfirmware
      import: app/west.yml
    - name: zmk-led-indicator
      remote: northwestisthebest
      revision: main
  self:
    path: config
```
